## meta-rz-features/meta-rz-opencva/conf/layer.conf
```bitbake
# We have a conf and classes directory, add to BBPATH
BBPATH .= ":${LAYERDIR}"

# We have recipes-* directories, add to BBFILES
BBFILES += "${LAYERDIR}/recipes-kernel/*.bbappend \
            ${LAYERDIR}/recipes-*/*/*.bb \
            ${LAYERDIR}/recipes-*/*/*.bbappend \
            ${LAYERDIR}/recipes-*/*/*/*.bb \
            ${LAYERDIR}/recipes-*/*/*/*.bbappend"

BBFILE_COLLECTIONS += "rz-opencva"
BBFILE_PATTERN_rz-opencva := "^${LAYERDIR}/"

LAYERDEPENDS_rz-opencva = "core meta-rz-bsp meta-rz-distro"
LAYERSERIES_COMPAT_rz-opencva = "scarthgap"

#Mask Codec Settings
BBMASK:append = " meta-rz-features/meta-rz-codecs/recipes-kernel/linux-renesas_6.1.bbappend"
BBMASK:append = " meta-rz-features/meta-rz-codecs/recipes-drp/drp/drp_1.2.0.bb"
BBMASK:append = " meta-rz-features/meta-rz-codecs/recipes-bsp/u-boot/u-boot_%.bbappend"
```
